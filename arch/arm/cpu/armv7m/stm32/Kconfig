## arch/arm/cpu/armv7m/stm32/Kconfig
```kconfig
if ARCH_STM32

config SYS_VENDOR
	default "st"

config SYS_SOC
	default "stm32"

config SYS_CONFIG_NAME
	default "stm32f429-discovery"

endif
```

## arch/arm/mach-rockchip/rk3368/Kconfig
```kconfig
if ROCKCHIP_RK3368

choice
	prompt "RK3368 board"

config TARGET_GEEKBOX
	bool "GeekBox"

endchoice

config SYS_SOC
	default "rockchip"

config SYS_MALLOC_F_LEN
	default 0x0800

source "board/geekbuying/geekbox/Kconfig"

endif
```

## board/amlogic/vega-s95/Kconfig
```kconfig
if TARGET_VEGA_S95

config SYS_BOARD
	default "vega-s95"

config SYS_VENDOR
	default "amlogic"

config SYS_CONFIG_NAME
	default "vega-s95"

endif
```

## board/imgtec/ci20/Kconfig
```kconfig
if TARGET_JZ4780_CI20

config SYS_BOARD
	default "ci20"

config SYS_VENDOR
	default "imgtec"

config SYS_CONFIG_NAME
	default "ci20"

config SYS_TEXT_BASE
	default 0x80000000

config JTAG
	bool
	default y

config SYS_AUDIO_SPEED
	int
	default 768000000

config SYS_EXTAL
	int
	default 48000000

config SYS_MEM_DIV
	int
	default 3

config SYS_MEM_SPEED
	int
	default 1200000000

endif
```

## configs/OptimusBoard_defconfig
```kconfig
CONFIG_SYS_EXTRA_OPTIONS=""
CONFIG_ARM=y
CONFIG_ARCH_SUNXI=y
CONFIG_MACH_SUN9I=y
CONFIG_TARGET_OPTIMUSBOARD=y
CONFIG_DEFAULT_DEVICE_TREE="sun9i-a80-optimus.dtb"
```

## configs/ci20_defconfig
```kconfig
CONFIG_MIPS=y
CONFIG_ARCH_JZ47XX=y
CONFIG_TARGET_JZ4780_CI20=y
CONFIG_DEFAULT_DEVICE_TREE="ci20"
CONFIG_SPL=y
CONFIG_SPL_SYS_MALLOC_SIMPLE=y
CONFIG_SYS_MMCSD_RAW_MODE_U_BOOT_USE_SECTOR=y
CONFIG_SYS_MMCSD_RAW_MODE_U_BOOT_SECTOR=0x1c
CONFIG_SPL_GPIO_SUPPORT=y
CONFIG_SPL_LIBGENERIC_SUPPORT=y
CONFIG_SPL_MMC_SUPPORT=y
CONFIG_SPL_MMC_TINY=y
CONFIG_JZ47XX_MMC=y
CONFIG_FIT=y
CONFIG_HUSH_PARSER=y
CONFIG_SYS_NO_FLASH=y
CONFIG_VERSION_VARIABLE=y
CONFIG_DISPLAY_CPUINFO=y
CONFIG_DISPLAY_BOARDINFO=y
CONFIG_BOARD_EARLY_INIT_F=y
# CONFIG_CMD_IMLS is not set
CONFIG_CMD_MMC=y
CONFIG_MMC=y
CONFIG_GENERIC_MMC=y
CONFIG_DM_MMC=y
# CONFIG_DM_MMC_OPS is not set
# CONFIG_BLK is not set
# CONFIG_SPL_DM_MMC is not set
CONFIG_CMD_DHCP=y
CONFIG_CMD_EXT4=y
CONFIG_CMD_FAT=y
CONFIG_JZ4780_EFUSE=y
CONFIG_JZ47XX_GPIO=y
CONFIG_USE_PRIVATE_LIBGCC=y
CONFIG_USE_TINY_PRINTF=y
CONFIG_SYS_NS16550=y
CONFIG_DM_SERIAL=y
CONFIG_SYS_DCACHE_SIZE=32768
CONFIG_SYS_ICACHE_SIZE=32768
CONFIG_SYS_DCACHE_LINE_SIZE=32
CONFIG_SYS_ICACHE_LINE_SIZE=32
# CONFIG_SPL_SERIAL_PRESENT is not set
# CONFIG_SPL_DOS_PARTITION is not set
# CONFIG_SPL_ISO_PARTITION is not set
```

## configs/stm32f429-discovery_defconfig
```kconfig
CONFIG_SPL=y
+S:CONFIG_ARM=y
+S:CONFIG_ARCH_STM32=y
+S:CONFIG_USE_PRIVATE_LIBGCC=y
```
